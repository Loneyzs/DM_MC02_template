## boards/damiao/dm_mc02/Kconfig.defconfig
```kconfig
# SPDX-License-Identifier: Apache-2.0

if BOARD_DM_MC02

config BOARD
	default "dm_mc02"

endif # BOARD_DM_MC02
```

## boards/damiao/dm_mc02/Kconfig.dm_mc02
```kconfig
# SPDX-License-Identifier: Apache-2.0

config BOARD_DM_MC02
	select SOC_STM32H723XX
```

## boards/damiao/dm_mc02/board.yml
```yaml
board:
  name: dm_mc02
  full_name: DM-MC-Board02
  vendor: damiao
  socs:
    - name: stm32h723xx
```

## boards/damiao/dm_mc02/dm_mc02_defconfig
```kconfig
# SPDX-License-Identifier: Apache-2.0

CONFIG_ARM_MPU=y
CONFIG_HW_STACK_PROTECTION=y

CONFIG_SERIAL=y
CONFIG_CONSOLE=y
CONFIG_USE_SEGGER_RTT=y
CONFIG_RTT_CONSOLE=y
CONFIG_UART_CONSOLE=n

CONFIG_GPIO=y
```
